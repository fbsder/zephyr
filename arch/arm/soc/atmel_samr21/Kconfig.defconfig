## arch/arm/soc/atmel_samr21/Kconfig.defconfig
```kconfig
# Kconfig - Atmel SAMR21 family processor configuration options

#
# Copyright (c) 2016 Intel Corporation.
# Copyright (c) 2014-2015 Wind River Systems, Inc.
#
# Licensed under the Apache License, Version 2.0 (the "License");
# you may not use this file except in compliance with the License.
# You may obtain a copy of the License at
#
#     http://www.apache.org/licenses/LICENSE-2.0
#
# Unless required by applicable law or agreed to in writing, software
# distributed under the License is distributed on an "AS IS" BASIS,
# WITHOUT WARRANTIES OR CONDITIONS OF ANY KIND, either express or implied.
# See the License for the specific language governing permissions and
# limitations under the License.
#

if SOC_ATMEL_SAMR21

config SOC
	default atmel_samr21

config NUM_IRQ_PRIO_BITS
	int
	default 2

#
# SAMR21 has total 28 peripherals capable of
# generating interrupts.
#
config NUM_IRQS
	int
	default 28

config SYS_CLOCK_HW_CYCLES_PER_SEC
	int
	default 48000000

config SRAM_SIZE
	default 32

config SRAM_BASE_ADDRESS
	default 0x20000000

#
# Atmel SAMR21 family has flash starting @ 0x00000000.
#
# SAMR21 has 256K of flash.
#
config FLASH_SIZE
	default 256 if SOC_ATMEL_SAMR21

config FLASH_BASE_ADDRESS
	default 0x00000000

if UART_ATMEL_SAMR21

config UART_ATMEL_SAMR21_BAUD_RATE
	int
	default 115200

config UART_ATMEL_SAMR21_CLK_FREQ
	int
	default SYS_CLOCK_HW_CYCLES_PER_SEC

endif # UART_ATMEL_SAMR21

if GPIO

config GPIO_ATMEL_SAMR21
	def_bool y

config GPIO_ATMEL_SAMR21_PORTA
	bool
	default y

config GPIO_ATMEL_SAMR21_PORTB
	bool
	default y

config GPIO_ATMEL_SAMR21_PORTC
	bool
	default y

config GPIO_ATMEL_SAMR21_PORTD
	bool
	default y

endif # GPIO

if I2C

config I2C_ATMEL_SAMR21
	def_bool y

config I2C_0
	default y
config I2C_0_IRQ_PRI
	default 0

config I2C_1
	default y

config I2C_1_IRQ_PRI
	default 0

endif # I2C

endif # SOC_ATMEL_SAMR21
```

## arch/arm/soc/atmel_samr21/Kconfig.soc
```kconfig
config SOC_ATMEL_SAMR21
	bool "Atmel SAMR21 Processor"
	select CPU_CORTEX_M
	select CPU_CORTEX_M0PLUS
	select XIP
	select SYS_POWER_LOW_POWER_STATE_SUPPORTED
	select CPU_HAS_SYSTICK
	select SOC_CLOCK_USE_PLL
```

## arch/arm/soc/st_stm32/stm32f3/Kconfig.defconfig.stm32f303x8
```kconfig
# Kconfig - ST Microelectronics STM32F303XC MCU
#
# Copyright (c) 2016 RnDity Sp. z o.o.
#
# SPDX-License-Identifier: Apache-2.0
#

if SOC_STM32F303X8

config SOC
	string
	default stm32f303x8

config SRAM_SIZE
	default 16

config FLASH_SIZE
	default 64

config FLASH_PAGE_SIZE
	hex
	default 0x800

config NUM_IRQS
	int
	default 82

endif # SOC_STM32F303X8
```

## boards/arm/nucleo_f303k8/Kconfig.board
```kconfig
# Kconfig - STM32 Nucleo-64 development board with STM32F334R8 MCU configuration
#
# Copyright (c) 2016 RnDity Sp. z o.o.
#
# SPDX-License-Identifier: Apache-2.0
#

config BOARD_NUCLEO_F303K8
	bool "NUCLEO-32 F303K8 Development Board"
	depends on SOC_STM32F303X8
```

## boards/arm/samr21_xpro/Kconfig.board
```kconfig
# Kconfig - ATMEL SAMR21 XPRO
#

config  BOARD_SAMR21_XPRO
	bool "ATMEL SAMR21 XPRO"
	depends on SOC_ATMEL_SAMR21
```

## boards/arm/samr21_xpro/Kconfig.defconfig
```kconfig
# Kconfig - SAMR21 XPRO board configuration
#

if BOARD_SAMR21_XPRO

config BOARD
	default samr21_xpro

endif # BOARD_SAMR21_XPRO
```

## boards/arm/samr21_xpro/samr21_xpro_defconfig
```kconfig
CONFIG_ARM=y
CONFIG_BOARD_SAMR21_XPRO=y
CONFIG_SOC_ATMEL_SAMR21=y
CONFIG_CORTEX_M_SYSTICK=y
CONFIG_FLASH=n
CONFIG_FLASH_SIZE=256
CONFIG_SRAM_SIZE=32
CONFIG_SRAM_BASE_ADDRESS=0x20000000
CONFIG_FLASH_BASE_ADDRESS=0x00000000
CONFIG_PRINTK=y

#enable GPIO driver
CONFIG_GPIO=y
CONFIG_GPIO_ATMEL_SAMR21=y
CONFIG_GPIO_ATMEL_SAMR21_PORT=y
CONFIG_GPIO_ATMEL_SAMR21_PORT_DEV_NAME="PIO_PORT"
CONFIG_GPIO_ATMEL_SAMR21_PORT_IRQ_PRI=3

# enable uart driver
CONFIG_SERIAL=y
CONFIG_SERIAL_HAS_DRIVER=y
CONFIG_UART_INTERRUPT_DRIVEN=y
CONFIG_UART_ATMEL_SAMR21=y
CONFIG_UART_ATMEL_SAMR21_IRQ_PRI=3

# enable console
CONFIG_CONSOLE=y
CONFIG_UART_CONSOLE=y

CONFIG_DEBUG=y
CONFIG_NET_LOG=y
```

## drivers/gpio/Kconfig.atmel_samr21
```kconfig
# Kconfig.atmel_sam3 - Atmel SAM3 GPIO configuration options
#
#
# Copyright (c) 2016 Intel Corporation
#
# SPDX-License-Identifier: Apache-2.0
#

menuconfig GPIO_ATMEL_SAMR21
	bool "Atmel SAMR21 PIO Controllers"
	depends on GPIO && SOC_ATMEL_SAMR21
	default n
	help
	  Enable config options to support the PIO controllers
	  on Atmel SAMR21 family processors.

	  Says n if not sure.

if GPIO_ATMEL_SAMR21

config GPIO_ATMEL_SAMR21_PORT
	bool "Enable driver for Atmel SAMR21 PIO Port"
	default n
	help
	  Build the driver to utilize PORT controller Port.

config GPIO_ATMEL_SAMR21_PORT_DEV_NAME
	string "Device name for Port"
	depends on GPIO_ATMEL_SAMR21_PORT
	default "PIO_PORT"
	help
	  Device name for Port.

config GPIO_ATMEL_SAMR21_PORT_IRQ_PRI
	int "Interrupt Priority for Port"
	depends on GPIO_ATMEL_SAMR21_PORT
	default 3
	help
	  Interrupt priority for Port.

endif # GPIO_ATMEL_SAMR21
```

## drivers/ieee802154/Kconfig.at86rf233
```kconfig
# Kconfig.at86rf233 - ATMEL AT86RF233 configuration options
#

menuconfig IEEE802154_AT86RF233
	bool "ATMEL AT86RF233 Driver support"
	depends on NETWORKING && SPI
	select NET_L2_IEEE802154
	default n

if IEEE802154_AT86RF233

config IEEE802154_AT86RF233_DRV_NAME
	string "Atmel AT86RF233 Driver's name"
	default "at86rf233"
	help
	This option sets the driver name
	
config IEEE802154_AT86RF233_RX_STACK_SIZE
	int "Driver's internal rx thread stack size"
	default 800
	help
	This option sets the driver's stack size for its internal rx thread.
	The default value should be sufficient, but in case it prooves to be
	a too little one, this option makes it easy to play with the size.

config IEEE802154_AT86RF233_INIT_PRIO
	int "AT86RF233 intialization priority"
	default 80
	help
	Set the initialization priority number. Do not mess with it unless
	you know what you are doing. Beware at86rf233 requires gpio and spi to
	be ready first (and sometime gpio should be the very first as spi
	might need it too). And of course it has to start before the net stack.
	
endif
```

## drivers/serial/Kconfig.atmel_samr21
```kconfig
menuconfig UART_ATMEL_SAMR21
	bool "Atmel SAMR21 family processor UART driver"
	default n
	select SERIAL_HAS_DRIVER
	depends on SOC_ATMEL_SAMR21
	help
	This option enables the UART driver for Atmel SAMR21
	family processors. Note that there is only one
	UART controller on SAMR21. It has only two wires
	for RX and TX, and does not have other pins
	(such as CTS and RTS).
	
if UART_ATMEL_SAMR21

config UART_ATMEL_SAMR21_NAME
	string "Device Name for Atmel SAMR21 UART"
	default "UART_0"
	help
	  This is the device name for UART, and is included in the device
	  struct.

config UART_ATMEL_SAMR21_IRQ_PRI
	int "Atmel SAMR21 UART Interrupt Priority"
	default 0
	help
	  The interrupt priority for UART port.

config UART_ATMEL_SAMR21_BAUD_RATE
	int "Atmel SAMR21 UART Baud Rate"
	default 0
	help
	  The baud rate for UART port to be set to at boot.

endif # UART_ATMEL_SAMR21
```
