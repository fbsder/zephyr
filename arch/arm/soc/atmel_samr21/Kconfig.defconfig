## ext/hal/atmel/samr21/Kconfig
```kconfig
#
# Copyright (c) 2016 Nordic Semiconductor ASA
#
# Licensed under the Apache License, Version 2.0 (the "License");
# you may not use this file except in compliance with the License.
# You may obtain a copy of the License at
#
#     http://www.apache.org/licenses/LICENSE-2.0
#
# Unless required by applicable law or agreed to in writing, software
# distributed under the License is distributed on an "AS IS" BASIS,
# WITHOUT WARRANTIES OR CONDITIONS OF ANY KIND, either express or implied.
# See the License for the specific language governing permissions and
# limitations under the License.
#

config HAS_ATMEL_SAMR21_HAL
	bool "Atmel SAMR21 Use Start HAL"
	depends on SOC_ATMEL_SAMR21
	default y if ARM && SOC_ATMEL_SAMR21
```
